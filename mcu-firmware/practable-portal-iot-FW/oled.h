#include "avr/pgmspace.h"





#define SCREEN_WIDTH 128  // OLED display width, in pixels
#define SCREEN_HEIGHT 64  // OLED display height, in pixels

#define OLED_ADDR 0x3C  //0x3C
Adafruit_SSD1306 display(SCREEN_WIDTH, SCREEN_HEIGHT, &Wire, -1, 100000UL);

#if (SSD1306_LCDHEIGHT != 64)
//#error("Height incorrect, please fix Adafruit_SSD1306.h!");
#endif



int logoW = 127;
int logoH = 42;


const unsigned char practLogo[] PROGMEM = {
  // 'practable-new-logo-big-font', 128x42px
  0x00, 0x00, 0x00, 0x00, 0x00, 0x00, 0x00, 0x00, 0x00, 0x00, 0x00, 0x00, 0x00, 0x00, 0x00, 0x00,
  0x00, 0x00, 0x00, 0xff, 0xf0, 0x00, 0x00, 0x00, 0x00, 0x00, 0x00, 0x00, 0x00, 0x00, 0x00, 0x00,
  0x00, 0x00, 0x01, 0xff, 0xf0, 0x00, 0x00, 0x00, 0x00, 0x00, 0x00, 0x00, 0x00, 0x00, 0x00, 0x00,
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  0x00, 0x00, 0x00, 0x00, 0x00, 0x00, 0x00, 0x00, 0x00, 0x00, 0x00, 0x00, 0x00, 0x00, 0x00, 0x00
};


void oled_begin() {  // Dont know what this does
  // SSD1306_SWITCHCAPVCC = generate display voltage from 3.3V internally
  if (!display.begin(SSD1306_SWITCHCAPVCC, OLED_ADDR)) {  // Address 0x3C for 128x32
    Serial.println(F("SSD1306 allocation failed"));
    //for (;;)
    ;  // Don't proceed, loop forever NOT
  } else {
    Serial.println(F("OLED Allocated"));
  }
  display.setTextColor(SSD1306_WHITE);
  display.clearDisplay();
  // display.setCursor(35, 10);
  // display.write("Starting Portal...");
  display.display();
}



void show_splash() {

  if (SHOW_SPASH_SCREEN) {
    display.drawBitmap(0, 20, practLogo, logoW, logoH, 1);  //(x , y bitMap, width, height, color)
    display.display();

    delay(1000);
    display.invertDisplay(true);
    delay(500);
    display.invertDisplay(false);
  }
}

// Lines per CHAR at 1.5 = 16
// yellow band = 16 lines




// for new stats screen

#define COL_0 2
#define COL_1 20
#define COL_2 65
#define COL_3 80

#define ROW_0 2
//#define ROW_1 16  // minimum to stop clipping the yellow
#define ROW_1 18
#define ROW_2 28
#define ROW_3 41
#define ROW_4 51

void power_stats_screen() {
  display.setTextColor(WHITE);
  display.drawRoundRect(0, 16, 128, 22, 2, WHITE);  // x, y, w, h, colour
  display.fillRoundRect(10, 27, 57, 9, 2, WHITE);   // x, y, w, h, colour
  display.setCursor(COL_0, ROW_1);
  display.print(F("Experiment: "));
  display.setCursor(COL_3, ROW_1);
  display.print(exp_W_buf);
  display.print(F(" W"));
  display.setCursor(COL_1, ROW_2);
  display.setTextColor(BLACK);
  display.print(adj_V_buf);
  display.print(F(" V  "));
  display.setCursor(COL_3, ROW_2);
  display.setTextColor(WHITE);
  display.print(adj_I_buf);
  display.print(F(" A  "));


  display.drawRoundRect(0, 39, 128, 22, 2, WHITE);  // x, y, w, h, colour
  display.fillRoundRect(10, 50, 57, 9, 2, WHITE);   // x, y, w, h, colour
  display.setCursor(COL_0, ROW_3);
  display.print(F("SBC: "));
  display.setCursor(COL_3, ROW_3);
  display.print(sbc_W_buf);
  display.print(F(" W"));
  display.setCursor(COL_1, ROW_4);
  display.setTextColor(BLACK);
  display.print(sbc_V_buf);
  display.print(F(" V  "));
  display.setCursor(COL_3, ROW_4);
  display.setTextColor(WHITE);
  display.print(sbc_I_buf);
  display.print(F(" A  "));
}



// MEM,
//  DISK,
//  UP,
//  IP,
//  MAC


void rpi_network_screen() {

  display.drawRoundRect(0, 16, 128, 48, 2, WHITE);  // x, y, w, h, colour
                                                    // display.fillRoundRect(9, 20, 110, 14, 4, WHITE);  // x, y, w, h, colour
  //display.setTextColor(BLACK);
  display.setTextColor(WHITE);
  char lineBuffer[126];

  display.setCursor(COL_0, 18);
  sprintf(lineBuffer, "%s %10s", stat_names[UP], stat_strings[UP]);
  //display.print(stat_names[UP]);

  // display.setCursor(128 - strlen(stat_strings[UP]) * 8, 18);
  // display.print(stat_strings[UP]);
  display.print(lineBuffer);

  display.setCursor(COL_0, 29);
  //display.print(stat_names[PING]);

  // display.setCursor(73+(45-pingPixels), 29);
  if (strcmp_P(stat_strings[PING], "0.0") == 0) {  // if time is equal to 0, then print text white
    sprintf(lineBuffer, "%s %8s\0", stat_names[PING], stat_strings[PING]);
    display.print(lineBuffer);
  } else {
    display.print(stat_names[PING]);
    display.setTextColor(BLACK);                     // else set text colour black and print a box to highlight number
    display.fillRoundRect(71, 28, 50, 9, 2, WHITE);  // x, y, w, h, colour
    display.setCursor(72, 29);
    sprintf(lineBuffer, "%8s", stat_strings[PING]);
    display.print(lineBuffer);
  }
  // display.print(stat_strings[PING]);
//  sprintf(lineBuffer, "%8s", stat_strings[PING]);
 // display.print(lineBuffer);


  // set text back to white
  display.setTextColor(WHITE);
  display.setCursor(COL_0, 41);
  // display.print(stat_names[IP]);
  // display.setCursor(126 - strlen(stat_strings[IP]) * 7, 41);
  if (strcmp_P(stat_strings[IP], "\0") == 0) {
    display.fillRoundRect(71, 40, 50, 9, 2, WHITE);  // x, y, w, h, colour
  }
  // display.print(stat_strings[IP]);
  sprintf(lineBuffer, "%s%16s\0", stat_names[IP], stat_strings[IP]);
  display.print(lineBuffer);

  display.setCursor(COL_0, 53);
  display.print(stat_names[MAC]);
  display.print(stat_strings[MAC]);
}

void rpi_stats_screen() {
  display.setTextColor(WHITE);
  //  display.clearDisplay();
  display.drawRoundRect(0, 16, 128, 48, 2, WHITE);  // x, y, w, h, colour
  display.setCursor(COL_0, 20);
  display.print(stat_names[TEMP]);
  display.print(stat_strings[TEMP]);
  display.print(stat_units[TEMP]);
  display.setCursor(COL_0, 31);
  display.print(stat_names[CPU]);
  display.print(stat_strings[CPU]);
  display.print(stat_units[CPU]);
  display.setCursor(COL_0, 43);
  display.print(stat_names[MEM]);
  display.print(stat_strings[MEM]);
  display.print(stat_units[MEM]);
  display.setCursor(COL_0, 54);
  display.print(stat_names[DISK]);
  display.print(stat_strings[DISK]);
  display.print(stat_units[DISK]);
}


void run_screen_num(screenState_t screen = POWER) {
  if (screen == POWER) {
    power_stats_screen();
  } else if (screen == NETWORK) {
    rpi_network_screen();
  } else if (screen == STATS) {
    rpi_stats_screen();
  } else {
    power_stats_screen();
    Serial.println("Error in screen state machine");
  }
}


void screen_timer(screenState_t screen = POWER) {
  if (screen == POWER) {
    if (millis() - screen_change_mS >= POWER_DISP_TIME_mS) {
      currentScreen = NETWORK;
      screen_change_mS = millis();
    }
  } else if (screen == NETWORK) {
    if (millis() - screen_change_mS >= NETWORK_DISP_TIME_mS) {
      currentScreen = STATS;
      screen_change_mS = millis();
    }
  } else if (screen == STATS) {
    if (millis() - screen_change_mS >= STATS_DISP_TIME_mS) {
      currentScreen = POWER;
      screen_change_mS = millis();
    }
  } else {
    currentScreen = POWER;
    Serial.println("Error in screen timer");
  }
}


void update_oled() {  // char *Vexp, char *Iexp, char *Vsbc, char *Isbc, char *sbcTrig, char *extTrig, char *expTrig, char *sbcReboot, char *expReboot) {
  display.clearDisplay();
  display.setTextSize(1.9);  // Draw 2X-scale text

  display.setTextColor(BLACK);
  display.fillRoundRect(0, 0, 128, 12, 2, WHITE);  // x, y, w, h, colour
  // display.setFont(&FreeMonoBold9pt7b);
  display.setCursor(COL_0, ROW_0);  //(x,y) (COL, ROW)
  if (sbc_power_cycle_state == 0) {
    display.print(F("  Practable Portal"));
  } else if (sbc_power_cycle_state == 2) {
    display.print(F("Rx SBC Shutdown"));
  } else if (sbc_power_cycle_state == 3) {
    display.print(F("SBC Power Off"));
  } else if (sbc_power_cycle_state == 4) {
    display.print(F("SBC Reboot"));
    show_splash();
  } else {
    display.print(F("Unknown State"));
  }
  // display.setTextSize(1.9);  // Draw 2X-scale text

  screen_timer(currentScreen);
  if (sbc_power_cycle_state == 4) {
    // dont run the normal screen
  } else {
    run_screen_num(NETWORK);  //currentScreen  NETWORK
  }
  // power_stats_screen();
  // rpi_network_screen();
  //  rpi_stats_screen();

  display.display();
}
